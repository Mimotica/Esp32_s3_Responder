## Kconfig.projbuild
```kconfig
menu "Example Configuration"

    config ESP_FTM_REPORT_LOG_ENABLE
        bool "FTM Report logging"
        default n
        depends on ESP_WIFI_FTM_INITIATOR_SUPPORT
        help
            Select this option to get a detailed report of FTM Procedure with raw values
    
    config ESP_FTM_REPORT_SHOW_DIAG
        bool "Show dialog tokens"
        default y
        depends on ESP_FTM_REPORT_LOG_ENABLE
    
    config ESP_FTM_REPORT_SHOW_RTT
        bool "Show RTT values"
        default y
        depends on ESP_FTM_REPORT_LOG_ENABLE
    
    config ESP_FTM_REPORT_SHOW_T1T2T3T4
        bool "Show T1 to T4"
        default y
        depends on ESP_FTM_REPORT_LOG_ENABLE
    
    config ESP_FTM_REPORT_SHOW_RSSI
        bool "Show RSSI levels"
        default y
        depends on ESP_FTM_REPORT_LOG_ENABLE
    
    endmenu
    
    menu "FTM Timing Precision"
        depends on ESP_WIFI_FTM_RESPONDER_SUPPORT || ESP_WIFI_FTM_INITIATOR_SUPPORT
    
    config FTM_HIGH_PRECISION
        bool "Enable FTM nanosecond precision"
        default y
        help
            Use PHY-provided nanosecond-resolution timestamps
            for FTM sessions instead of microsecond fallback.
    
    endmenu
    
```
